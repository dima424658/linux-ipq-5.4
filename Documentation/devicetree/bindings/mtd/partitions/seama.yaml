## Documentation/devicetree/bindings/mtd/partitions/seama.yaml
```yaml
# SPDX-License-Identifier: (GPL-2.0-only OR BSD-2-Clause)
%YAML 1.2
---
$id: http://devicetree.org/schemas/mtd/partitions/seama.yaml#
$schema: http://devicetree.org/meta-schemas/core.yaml#

title: Seattle Image Partitions

description: The SEAttle iMAge (SEAMA) partition is a type of partition
  used for NAND flash devices. This type of flash image is found in some
  D-Link routers such as DIR-645, DIR-842, DIR-859, DIR-860L, DIR-885L,
  DIR890L and DCH-M225, as well as in WD and NEC routers on the ath79
  (MIPS), Broadcom BCM53xx, and RAMIPS platforms.

maintainers:
  - Linus Walleij <linus.walleij@linaro.org>

select: false

properties:
  compatible:
    const: seama

  '#address-cells': false

  '#size-cells': false

patternProperties:
  "@[0-9a-f]+$":
    $ref: partition.yaml#

required:
  - compatible

additionalProperties: false

examples:
  - |
    flash {
      partitions {
        compatible = "fixed-partitions";
        #address-cells = <1>;
        #size-cells = <1>;
        firmware@0 {
          compatible = "seama";
          label = "firmware";
          reg = <0x00000000 0x08000000>;
        };
      };
    };
```
